## Kernel/drivers/char/misc_ori/Kconfig
```kconfig
#
# Character device configuration
#

menu "Character misc devices"

config KORAIL_MAIN_BOARD
	bool "korail v210 board type"
	depends on KORAIL_DEVICE
	default n
	---help---
	  korail v210 board type.
	  
config KORAIL_DEVICE_HWID
	bool "korail v210 device HW ID"
	depends on KORAIL_DEVICE
	default n
	---help---
	  korail v210 board device hw ID. 

config KORAIL_DEVICE_DIPSWITCH
	bool "korail v210 device HW DIP Switch"
	depends on KORAIL_DEVICE
	default n
	---help---
	  korail v210 board device hw dip Switch.

config KORAIL_DEVICE_TCOLOR_LED
	bool "korail v210 device 3 color led"
	depends on KORAIL_DEVICE
	default n
	---help---
	  korail v210 board device 3 color led.

config KORAIL_DEVICE_BUZZER
	bool "korail v210 device Buzzer"
	depends on KORAIL_DEVICE
	default n
	---help---
	  korail v210 board device Buzzer.

config KORAIL_DEVICE_FND
	bool "korail v210 device FND"
	depends on KORAIL_DEVICE
	default n
	---help---
	  korail v210 board device FND.

config KORAIL_DEVICE_SIM
	bool "korail v210 device SIM"
	depends on KORAIL_DEVICE
	default n
	---help---
	  korail v210 board device SIM.
	  
config KORAIL_DEVICE_KEYS
	bool "korail v210 device HW KEYS"
	depends on KORAIL_DEVICE
	default n
	---help---
	  korail v210 board device hw keys.

config KORAIL_DEVICE_RC531
	bool "korail v210 device RF RC531"
	depends on KORAIL_DEVICE
	default n
	---help---
	  korail v210 board device rf rc531
	  
config KORAIL_DEVICE_GATE_IO
	bool "korail v210 device HW Gate IO"
	depends on KORAIL_DEVICE
	default n
	---help---
	  korail v210 board device hw gate io.

config KORAIL_DEVICE_RS485
	bool "korail v210 device RS-485 Flow control"
	depends on KORAIL_DEVICE
	default n
	---help---
	  korail v210 board device RS-485 Flow control.

config KORAIL_DEVICE_DS1338
	bool "korail v210 device ds1338z rtc nv ram"
	depends on KORAIL_DEVICE
	default n
	---help---
	  korail v210 board device ds1338z rtc nv ram.

config KORAIL_DEVICE_TTLIO
	bool "korail v210 device ttl io"
	depends on KORAIL_DEVICE
	default n
	---help---
	  korail v210 board device ttl io.

endmenu
```

## Kernel/drivers/video/logo/Kconfig
```kconfig
#
# Logo configuration
#

menuconfig LOGO
	bool "Bootup logo"
	depends on FB || SGI_NEWPORT_CONSOLE
	help
	  Enable and select frame buffer bootup logos.

if LOGO

config FB_LOGO_EXTRA
	bool
	depends on FB=y
	default y if SPU_BASE

config LOGO_LINUX_MONO
	bool "Standard black and white Linux logo"
	default y

config LOGO_LINUX_VGA16
	bool "Standard 16-color Linux logo"
	default y

config LOGO_LINUX_CLUT224
	bool "Standard 224-color Linux logo"
	default y

config LOGO_BLACKFIN_VGA16
	bool "16-colour Blackfin Processor Linux logo"
	depends on BLACKFIN
	default y

config LOGO_BLACKFIN_CLUT224
	bool "224-colour Blackfin Processor Linux logo"
	depends on BLACKFIN
	default y

config LOGO_DEC_CLUT224
	bool "224-color Digital Equipment Corporation Linux logo"
	depends on MACH_DECSTATION || ALPHA
	default y

config LOGO_MAC_CLUT224
	bool "224-color Macintosh Linux logo"
	depends on MAC
	default y

config LOGO_PARISC_CLUT224
	bool "224-color PA-RISC Linux logo"
	depends on PARISC
	default y

config LOGO_SGI_CLUT224
	bool "224-color SGI Linux logo"
	depends on SGI_IP22 || SGI_IP27 || SGI_IP32 || X86_VISWS
	default y

config LOGO_SUN_CLUT224
	bool "224-color Sun Linux logo"
	depends on SPARC
	default y

config LOGO_SUPERH_MONO
	bool "Black and white SuperH Linux logo"
	depends on SUPERH
	default y

config LOGO_SUPERH_VGA16
	bool "16-color SuperH Linux logo"
	depends on SUPERH
	default y

config LOGO_SUPERH_CLUT224
	bool "224-color SuperH Linux logo"
	depends on SUPERH
	default y

config LOGO_M32R_CLUT224
	bool "224-color M32R Linux logo"
	depends on M32R
	default y

config LOGO_HYBUS_800_480_CLUT224
	bool "HYBUS 800*480 logo"
	default y

config LOGO_VATEK_800_480_CLUT224
	bool "VATEK 800*480 logo"
	default y
	
config LOGO_VATEK_GREEN_800_480_CLUT224
	bool "VATEK GREEN 800*480 logo"
	default y

config LOGO_KORAIL_CLUT224
	bool "KORAIL 480*272 logo"
	default y

endif # LOGO
```
